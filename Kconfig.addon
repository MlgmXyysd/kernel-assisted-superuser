## Kconfig.addon
```kconfig
config ASSISTED_SUPERUSER
	bool "Kernel-assisted superuser"
	---help---
	  This driver gives trivial root access by typing `su` in a
	  shell. It is a security disaster, and nobody should enable
	  this catastrophe of a driver.

	  Say N here unless you have a vendetta against kittens.
```
